## boards/arm/adafruit_clue/Kconfig.board
```kconfig
# Adafruit CLUE board configuration
# SPDX-License-Identifier: Apache-2.0

config BOARD_ADAFRUIT_CLUE
	bool "Adafruit CLUE"
	depends on SOC_NRF52840_QIAA
```

## boards/arm/adafruit_clue/Kconfig.defconfig
```kconfig
# Adafruit CLUE board configuration

# Copyright (c) 2020 Tobias Svehagen
# SPDX-License-Identifier: Apache-2.0

if BOARD_ADAFRUIT_CLUE

config BOARD
	default "adafruit_clue"

if USB

config USB_NRFX
	default y

config USB_DEVICE_STACK
	default y

endif # USB

config BT_CTLR
	default BT

endif # BOARD_ADAFRUIT_CLUE
```
